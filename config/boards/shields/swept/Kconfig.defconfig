## config/boards/shields/swept/Kconfig.defconfig
```kconfig
# Copyright (c) 2022 The ZMK Contributors
# SPDX-License-Identifier: MIT

if SHIELD_SWEPT_LEFT

config ZMK_KEYBOARD_NAME
    default "Swept"

config ZMK_SPLIT_ROLE_CENTRAL
    default y

config ZMK_USB
    default y

endif # SHIELD_SWEPT_LEFT

if SHIELD_SWEPT_RIGHT

config ZMK_DISPLAY
    select LV_FONT_MONTSERRAT_26

if ZMK_DISPLAY

config ZMK_DISPLAY_BLANK_ON_IDLE
  default n

config SPI
    default y

config LS0XX
    default y

# config ZMK_WIDGET_WPM_STATUS
#   default y if !ZMK_SPLIT || ZMK_SPLIT_ROLE_CENTRAL

config LV_Z_BITS_PER_PIXEL
    default 1

choice LV_COLOR_DEPTH
    default LV_COLOR_DEPTH_1
endchoice

endif # ZMK_DISPLAY

endif # SHIELD_SWEPT_RIGHT

if SHIELD_SWEPT_LEFT || SHIELD_SWEPT_RIGHT

config ZMK_SPLIT
    default y

if ZMK_MOUSE

config I2C
  default y

endif # ZMK_MOUSE

if LVGL

config LV_Z_VDB_SIZE
    default 64

config LV_DPI_DEF
    default 148

config LV_Z_BITS_PER_PIXEL
    default 1

choice LV_COLOR_DEPTH
    default LV_COLOR_DEPTH_1

endchoice

endif # LVGL

endif # SHIELD_SWEPT_LEFT || SHIELD_SWEPT_RIGHT
```

## config/boards/shields/swept/Kconfig.shield
```kconfig
# Copyright (c) 2022 The ZMK Contributors
# SPDX-License-Identifier: MIT

config SHIELD_HILLSIDE_VIEW_LEFT
    def_bool $(shields_list_contains,swept_left)

config SHIELD_HILLSIDE_VIEW_RIGHT
    def_bool $(shields_list_contains,swept_right)
```
